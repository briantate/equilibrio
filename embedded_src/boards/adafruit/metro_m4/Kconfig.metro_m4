## embedded_src/boards/adafruit/metro_m4/Kconfig.metro_m4
```kconfig
# Copyright (c) 2019 Benjamin Valentin
# Copyright (c) 2024 Gerson Fernando Budke <nandojve@gmail.com>
# Copyright (c) 2025 Brian Tate <brian.c.tate@gmail.com>
# SPDX-License-Identifier: Apache-2.0

config BOARD_METRO_M4
	select SOC_SAMD51J19A
```

## embedded_src/boards/adafruit/metro_m4/board.yml
```yaml
board:
  name: metro_m4
  full_name: Adafruit Metro M4 Board
  vendor: Adafruit
  socs:
    - name: samd51j19a
```
